## config/boards/shields/1984x/Kconfig.defconfig
```kconfig
if SHIELD_1984X_RIGHT

config ZMK_KEYBOARD_NAME
    default "1984x"

config ZMK_SPLIT_BLE_ROLE_CENTRAL
    default y

endif

if SHIELD_1984X_LEFT || SHIELD_1984X_RIGHT
config ZMK_SPLIT
  default y

endif
```

## config/boards/shields/1984x/Kconfig.shield
```kconfig
config SHIELD_1984X_LEFT
    def_bool $(shields_list_contains,1984x_left)

config SHIELD_1984X_RIGHT
    def_bool $(shields_list_contains,1984x_right)

config LEFT
    bool "Left Side"
    default n

config RIGHT
    bool "Right Side"
    default n
```

## config/west.yml
```yaml
# manifest:
#   remotes:
#     - name: zmkfirmware
#       # url-base: https://github.com/t0bybr
#       url-base: https://github.com/urob
#   projects:
#     - name: zmk
#       remote: zmkfirmware
#       revision: main
#       import: app/west.yml
#     # - name: miryoku
#     #   url: https://github.com/t0bybr/miryoku_zmk.git
#     #   revision: master
#     #   path: miryoku_zmk
#   self:
#     path: config


#manifest:
#  remotes:
#    - name: urob
#      url-base: https://github.com/urob
#    - name: t0bybr
#      url-base: https://github.com/t0bybr

#  projects:
 #    - name: zmk
  #    remote: urob
#      revision: main
#      import: app/west.yml
#    - name: zmk-helpers
#      remote: urob
#      revision: main
#      path: modules/helpers
#    - name: zmk-auto-layer
#      remote: urob
#      revision: main
#      path: modules/auto-layer
#    - name: zmk-tri-state
#      remote: urob
#      revision: main
#      path: modules/tri-state
 #    - name: pim447
 #     remote: t0bybr
 #     revision: main


  #self:
   # path: config


manifest:
  defaults:
    remote: urob

  remotes:
    - name: upstream
      url-base: https://github.com/zmkfirmware
    - name: urob
      url-base: https://github.com/urob
    - name: t0bybr
      url-base: https://github.com/t0bybr

  projects:
    - name: zmk-helpers
      revision: main
      path: modules/helpers
    - name: zmk-auto-layer
      revision: main
      path: modules/auto-layer
    - name: zmk-tri-state
      revision: main
      path: modules/tri-state
    - name: pim447
      remote: t0bybr
      revision: main

    # ZMK with Zephyr namespaced under /zmk. This requires that ZMK imports
    # Zephyr with a path other than `zephyr` (as in `going-modular`).
    - name: zmk
      revision: going-modular
      path: .
      import:
        file: app/west.yml
        path-prefix: zmk

  self:
    path: config
```
